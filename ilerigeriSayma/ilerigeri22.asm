list p=16f877A
    #INCLUDE <P16F877A.INC>
   
    __CONFIG  H'3F31'
    ;__CONFIG  H'2F01'
   ORG 0X00
   
    SAYAC1  EQU 0X20
    SAYAC2  EQU 0X21
   
 
    GOTO BASLA
   
    BASLA
    BANKSEL TRISA
    MOVLW   0X06
    MOVWF   ADCON1
    MOVLW   B'00110000'
    MOVWF   TRISA
    CLRF    TRISB
   
    BANKSEL PORTA
    CLRF    PORTA
    CLRF    PORTB
   
    GOTO ARTTIR
   
    KONTROL_ARTTIR
   
    CALL    GECIKME
    CALL    GECIKME
    BTFSS   PORTA,4
    GOTO    AZALT
    GOTO    ARTTIR
   
    KONTROL_AZALT
   

    CALL    GECIKME
    CALL    GECIKME
    BTFSS   PORTA,5
    GOTO    ARTTIR
    GOTO    AZALT
   
   
    ARTTIR
   
    INCFSZ  PORTB
    GOTO    KONTROL_AZALT
    INCF    PORTA
    GOTO    ARTTIR

   
    AZALT
   
    DECFSZ  PORTB
    GOTO    KONTROL_ARTTIR
    DECF    PORTA
    GOTO    AZALT
   
    GECIKME    ;TOPLAMDA:196608 ÇEVR?M 4MHZ KR?STAL ?Ç?N

    MOVLW H'FF'    ;BU KOMUT 1 ÇEVR?M
    MOVWF SAYAC1    ;BU KOMUTTA 1 ÇEVR?M

    DONGU1
    MOVLW H'FF'    ;1X256 ÇEVR?M (255 H'FF' SAYISINA KARSILIK GEL?YOR)
    MOVWF SAYAC2    ;1X256 ÇEVR?M

    DONGU2
    DECFSZ SAYAC2,F ;1X256X256 ÇEVR?M (SAYAC1 VE SAYAC2 ?ÇER??? 255 OLDUGUNDAN )

    GOTO DONGU2    ;2X255X255 (GOTO 2 ÇEVR?M OLDUGUNDAN 2 ?LE ÇARPTIK)

    DECFSZ SAYAC1,F ;1X255
    GOTO DONGU1    ;2X255
    RETURN
   
   
    BITIR
    NOP
    NOP
    END  