#INCLUDE  <P16F877A.INC>
LIST 		P=16F877A
 __CONFIG  H'3F31'
 ;__CONFIG  H'2F01'
ORG		0X00
GECIKME1	EQU	0x20    ; GEC?KME 1. DONGU
GECIKME2	EQU	0x21    ; GECIKME 2. DONGU
GECIKME3	EQU	0x22    ; GECIKME 3.DONGU

DUSUK_4			EQU	0x23	; 4 BITLIK KOMUT GONDERIMINDE KULLANILACAK
VERI				EQU	0x24	; 8 BITLIK LCD VERISI TUTULACAK
SATIR_KONUM	EQU	0x25	; LCD EKRANIN GIDILECEK SATIR BILGISI
SUTUN_KONUM	EQU	0x26	; LCD EKRANIN GIDILECEK SUTUN BILGISI

ILK_DEGER	EQU	0X27
SON_DEGER	EQU	0X28	
ISLEM_REG	EQU	0X29
BIRLER		EQU	0X2A
ONLAR		EQU	0X2B
YUZLER		EQU	0X2C
ARA			EQU	0X2D
SONUC		EQU	0X2E
		
CALL	LCD_AYARLA
GOTO	KONTROL

GECIKME_200USN				
	MOVLW	0xC8
	MOVWF	GECIKME1
	DNGU1
	DECFSZ	GECIKME1,1 
	GOTO	DNGU1	    	
	RETURN
	
GECIKME_5MSN
	movlw	0xE7
	movwf	GECIKME1
	movlw	0x04
	movwf	GECIKME2
	CALL	GECIKTIR
	RETURN
	
GECIKME_50MSN
	movlw	0x0F
	movwf	GECIKME1
	movlw	0x28
	movwf	GECIKME2
	CALL	GECIKTIR
	RETURN

GECIKME_196MS
	movlw	0xFF
	movwf	GECIKME1
	movlw	0xFF
	movwf	GECIKME2
	CALL	GECIKTIR
	RETURN
GECIKTIR
	decfsz	GECIKME1, f
	goto	GECIKTIR
	decfsz	GECIKME2, f
	goto	GECIKTIR
	RETURN
;******************************************************************************************************
	
DUSEN_KENAR
	BANKSEL	PORTB
	BSF	PORTB,5		;E UCUNU ONCE 1 YAP
	CALL	GECIKME_200USN	;ASLINDA BU KADAR UZUN OLMAK ZORUNDA DEGIL
	BCF	PORTB,5		; E UCUNU TEKRAR 0 YAP
	RETURN
	
	KOMUT_4BIT
	; BU FONKSIYON 4 BITLIK KOMUT GONDERME ICIN KULLANILIR
	;BURADA DIKKAT EDILMESI GEREKEN PORTB NIN AYAR BITLERINI DE ICEREN 4-7 NOLU BITLERININ DURUMLARININ BOZULMAMASI
	;GONDERILECEK 4 BIT BU FONKSIYON CAGRILMADAN	W YA YUKLENMELI. BUNLARI BIT BIT GONDERMEKTENSE MEVCUT PORTB NIN
	;DEGERLI 4 BITI ILE GELEN W VERISININ 4 BITINI BIRLESTIR
	ANDLW	0x0F	; W 'DAKI DEGERIN SADECE ILK DORT BITINI AL SAKLA
	MOVWF	DUSUK_4
	MOVFW	PORTB	; PORTB NIN EN DEGERLI 4 BITINI ALMAK ICIN W 'YA GETIR
	ANDLW	0xF0	; SADECE EN DEGERLI 4 BITI
	IORWF	DUSUK_4,W   ; ILK DORT BITI TUTAN DEGISKEN ILE PORTB NIN SON 4 UNU VEYA ISLEMI ILE BIRLESTIR
	MOVWF	PORTB	;BIRLESMIS VERIYI LCD YE GONDER. BOYLECE MEVCUT PORTB DURUMU KORUNMUS OLDU
	CALL	DUSEN_KENAR ; KOMUT GONDERMEK ICIN E UCUNAN DUSEN KENAR GONDER
	CALL	GECIKME_200USN
	RETURN
	
	KOMUT_8BIT
	; BU FONKSIYON 8 BITLIK KOMUT GONDERMEK ICIN KULLANILACAK. CALISMASINDA YUKARIDAKI KOMUT_4 FONKSIYONUNDAN
	; FAYDALANACAK. BU FONKSIYON CAGRILDIGINDA GONDERILECEK VERI W 'YA YUKLENMIS OLMALI
	; GONDERILECEK KOMUTUN ONCE EN DEGERLIKLI 4 BITI SONRA EN DEGERLIKSIZ 4 BITI GONDERILECEK
	; ONCE EN DEGERLI 4 BITINI GONDERMEK ICIN SWAPF KOMUTU ILE SON 4 BIT BASA GETIRILIR
	MOVWF	VERI	; ONCE GONDERILECEK VERIYI SAKLA
	SWAPF	VERI,W	; GONDERILECEK VERININ ILK DOR VE SON DORT BITINI YER DEGISTIR VE W YA AT
	BANKSEL	PORTB
	BCF	PORTB,4	; RS UCUNU 0 A CEK VE KOMUT GONDERECEGINI SOYLE
	CALL	KOMUT_4BIT  ; BU EN DEGERLIKLI 4 BITI YOLLA
	MOVF	VERI,W	    ; SIMDI EN DEGERLIKSIZ 4 U GONDER ( VERI DEGISKENI NORMAL DURUMU TUTUYORDU)
	BCF	PORTB,4	; RS UCUNU 0 A CEK VE KOMUT GONDERECEGINI SOYLE
	CALL	KOMUT_4BIT
	
	RETURN
LCD_KARAKTER_YAZ
	MOVWF	VERI	    ; GELEN VERI ICIN SWAP ISLEMI YAPILACAGINDAN KORU
	SWAPF	VERI,W	    ; EN DEGERLIKLI BITLER ICIN SWAP YAP
	BANKSEL	PORTB
	BSF	PORTB,4	    ; KARAKTER YAZMA ICIN RS=1
	CALL	KOMUT_4BIT  ; 4 BIT MODUNDA KARAKTERI GONDER
	MOVFW	VERI	    ; SIMDI NORMAL DUSUK DEGERLIKLI BITLERI GONDER
	CALL	KOMUT_4BIT
	RETURN
	
;****************************************************************************************************
LCD_AYARLA
	BANKSEL	TRISD
	MOVLW	0XF0
	MOVWF	TRISD
	BANKSEL	TRISB
	CLRF	TRISB
	MOVLW	0X0F
	MOVWF	TRISD

	BANKSEL	PORTB
	BSF	PORTD,4
	CALL	GECIKME_50MSN	;LCD ILK ACILIS GECIKMESI
	
	BCF	PORTB,4		;RS UCUNU 0 YAPARAK LCD YE KOMUT GONDERECEGINI SOYLE
	
	MOVLW	0x03
	CALL	KOMUT_4BIT
	CALL	GECIKME_5MSN
	
	CALL	DUSEN_KENAR
	CALL	GECIKME_200USN
	CALL	DUSEN_KENAR
	CALL	GECIKME_200USN
	
	BCF	PORTB,4
	MOVLW	0x02
	CALL	KOMUT_4BIT
	CALL	GECIKME_200USN
	
	MOVLW	0x28
	CALL	KOMUT_8BIT
	
	MOVLW	0x10		; EKRAN AKTIF, IMLEC YAN SON
	CALL	KOMUT_8BIT
	
	MOVLW	0x01
	CALL	KOMUT_8BIT
	
	CALL	GECIKME_5MSN
	
	MOVLW	0x06
	CALL	KOMUT_8BIT
	
	MOVLW	0x0D
	CALL	KOMUT_8BIT
	
	RETURN
;*******************************************************************************************************
	
KURSOR_KONUM
	MOVLW	0x80		    ; EKRANIN ILK SATIR BIRINCI SUTUN NOKTA KOORDINATI 0x80 DIR
	MOVF	SATIR_KONUM,1	    ; KENDI UZERINE KOPYALA, EGER 0 ISE SIFIRINCI SATIRDA KAL
	BTFSS	STATUS,Z	    ; EGER DEGILSE IKINCI SATIR BASLANGIC ADRESI 0x80 DEN BASLA
	MOVLW	0xC0
	ADDWF	SUTUN_KONUM,W	    ; SATIR BELLI OLDU SUTUN SAYISINI EKLE VE KONUMA GIT
	CALL	KOMUT_8BIT
	RETURN

;*******************************************************************************************************
	
	KONTROL
	BTFSC		PORTD,0
	CALL		SATIR0
	BTFSC		PORTD,1
	CALL		SATIR1
	BTFSC		PORTD,2
	CALL		SATIR2
	BTFSC		PORTD,3
	CALL		SATIR3
	
	BTFSS		PORTD,7
	GOTO		$+4
	MOVLW		B'00010000'
	MOVWF		PORTD
	GOTO		KONTROL
	
	RLF		PORTD
	GOTO		KONTROL
	
	SATIR0
	BTFSC		PORTD,4
	CALL		SAYI_7
	BTFSC		PORTD,5
	CALL		SAYI_8
	BTFSC		PORTD,6
	CALL		SAYI_9
	BTFSC		PORTD,7
	CALL		BOLME
	RETURN
	
	SATIR1
	BTFSC		PORTD,4
	CALL		SAYI_4
	BTFSC		PORTD,5
	CALL		SAYI_5
	BTFSC		PORTD,6
	CALL		SAYI_6
	BTFSC		PORTD,7
	CALL		CARPMA
	RETURN
	
	SATIR2
	BTFSC		PORTD,4
	CALL		SAYI_1
	BTFSC		PORTD,5
	CALL		SAYI_2
	BTFSC		PORTD,6
	CALL		SAYI_3
	BTFSC		PORTD,7
	CALL		CIKARMA
	RETURN
	
	SATIR3
	BTFSC		PORTD,4
	CALL		TEMIZLE
	BTFSC		PORTD,5
	CALL		SAYI_0
	BTFSC		PORTD,6
	CALL		ESITTIR
	BTFSC		PORTD,7
	CALL		TOPLAMA
	RETURN
	
DEGER_TEMIZLE
	CLRF	BIRLER
	CLRF	ONLAR
	CLRF	YUZLER
	CLRF	SONUC
	CLRF	ARA
	RETURN
	
DEGISTIR
	MOVWF	ARA
	MOVFW	ONLAR
	MOVWF	YUZLER
	
	MOVFW	BIRLER
	MOVWF	ONLAR
	
	MOVFW	ARA
	MOVWF	BIRLER
	RETURN
SAYI_0
	CALL	GECIKME_196MS
	MOVLW	'0'
	CALL	LCD_KARAKTER_YAZ
	MOVLW	0X00
	CALL	DEGISTIR
	RETURN
	
SAYI_1
	CALL	GECIKME_196MS
	MOVLW	'1'
	CALL	LCD_KARAKTER_YAZ
	MOVLW	0X01
	CALL	DEGISTIR
	RETURN
	
	
SAYI_2
	CALL	GECIKME_196MS
	MOVLW	'2'
	CALL	LCD_KARAKTER_YAZ
	MOVLW	0X02
	CALL	DEGISTIR
	RETURN
	
	
SAYI_3
	CALL	GECIKME_196MS
	MOVLW	'3'
	CALL	LCD_KARAKTER_YAZ
	MOVLW	0X03
	CALL	DEGISTIR
	RETURN
	
	
SAYI_4
	CALL	GECIKME_196MS
	MOVLW	'4'
	CALL	LCD_KARAKTER_YAZ
	MOVLW	0X04
	CALL	DEGISTIR
	RETURN
	
	
SAYI_5
	CALL	GECIKME_196MS
	MOVLW	'5'
	CALL	LCD_KARAKTER_YAZ
	MOVLW	0X05
	CALL	DEGISTIR
	RETURN
	
	
SAYI_6
	CALL	GECIKME_196MS
	MOVLW	'6'
	CALL	LCD_KARAKTER_YAZ
	MOVLW	0X06
	CALL	DEGISTIR
	RETURN
	
	
SAYI_7
	CALL	GECIKME_196MS
	MOVLW	'7'
	CALL	LCD_KARAKTER_YAZ
	MOVLW	0X07
	CALL	DEGISTIR
	RETURN
	
SAYI_8
	CALL	GECIKME_196MS
	MOVLW	'8'
	CALL	LCD_KARAKTER_YAZ
	MOVLW	0X08
	CALL	DEGISTIR
	RETURN
	
SAYI_9
	CALL	GECIKME_196MS
	MOVLW	'9'
	CALL	LCD_KARAKTER_YAZ
	MOVLW	0X09
	CALL	DEGISTIR
	RETURN
	
LCD_SAYI_DEGERIMIZ
	CLRF	SONUC

	MOVLW	0X00
	SUBWF	YUZLER,W
	BTFSS	STATUS,Z
	CALL	YUZLUK
	MOVLW	0X00
	SUBWF	ONLAR,W
	BTFSS	STATUS,Z
	CALL	ONLUK

	MOVFW	ONLAR
	ADDWF	SONUC,F
	
	MOVFW	BIRLER
	ADDWF	SONUC,F
	
	MOVFW	SONUC
	RETURN

	ONLUK
	MOVLW	D'10'
	ADDWF	SONUC,F
	DECFSZ	ONLAR
	GOTO	ONLUK
	MOVFW	SONUC
	MOVWF	ONLAR	
	CLRF	SONUC
	RETURN
	
	YUZLUK
	MOVLW	D'100'
	ADDWF	SONUC,F
	DECFSZ	YUZLER
	GOTO	YUZLUK
	RETURN

	
TOPLAMA
	CALL	GECIKME_196MS
	MOVLW	'+'
	CALL	LCD_KARAKTER_YAZ
	CALL	LCD_SAYI_DEGERIMIZ
	MOVWF	ILK_DEGER
	
	CALL	DEGER_TEMIZLE
	BSF	ISLEM_REG,0
	RETURN
	
CIKARMA
	CALL	GECIKME_196MS
	MOVLW	'-'
	CALL	LCD_KARAKTER_YAZ
	CALL	LCD_SAYI_DEGERIMIZ
	MOVWF	ILK_DEGER
	
	CALL	DEGER_TEMIZLE
	BSF	ISLEM_REG,1
	RETURN
	
CARPMA
	CALL	GECIKME_196MS
	MOVLW	'*'
	CALL	LCD_KARAKTER_YAZ
	CALL	LCD_SAYI_DEGERIMIZ
	MOVWF	ILK_DEGER
	
	CALL	DEGER_TEMIZLE
	BSF	ISLEM_REG,2
	RETURN
	
BOLME
	CALL	GECIKME_196MS
	MOVLW	'/'
	CALL	LCD_KARAKTER_YAZ
	CALL	LCD_SAYI_DEGERIMIZ
	MOVWF	ILK_DEGER
	
	CALL	DEGER_TEMIZLE
	BSF	ISLEM_REG,3
	RETURN
	
TEMIZLE
	CALL	GECIKME_196MS
	CALL	DEGER_TEMIZLE
	CLRF	ISLEM_REG
	
	BCF	PORTB,4
	MOVLW	0x01
	CALL	KOMUT_8BIT
	CALL	GECIKME_200USN	
	RETURN
	
ESITTIR
	CALL	GECIKME_196MS
	CALL	LCD_SAYI_DEGERIMIZ
	MOVWF	SON_DEGER
	CLRF	SONUC
	
	BTFSC	ISLEM_REG,0
	CALL	TOPLAM_SONUC
	BTFSC	ISLEM_REG,1
	CALL	CIKARMA_SONUC
	BTFSC	ISLEM_REG,2
	CALL	CARPMA_SONUC
	BTFSC	ISLEM_REG,3
	CALL	BOLME_SONUC
	
	CLRF	ISLEM_REG
	CLRF	BIRLER
	CLRF	ONLAR
	CLRF	YUZLER

	CALL	KARAKTER_BOL
	
	MOVLW	0XC0
	CALL	KOMUT_8BIT
	
	
	MOVLW	D'48'
	ADDWF	YUZLER,W
	CALL	LCD_KARAKTER_YAZ
	
	MOVLW	D'48'
	ADDWF	ONLAR,W
	CALL	LCD_KARAKTER_YAZ
	
	MOVLW	D'48'
	ADDWF	BIRLER,W
	CALL	LCD_KARAKTER_YAZ
	
	RETURN
TOPLAM_SONUC
	MOVFW	ILK_DEGER
	ADDWF	SON_DEGER,W
	MOVWF	SONUC
	RETURN

CIKARMA_SONUC
	MOVFW	SON_DEGER
	SUBWF	ILK_DEGER,W
	MOVWF	SONUC
	RETURN

CARPMA_SONUC
	MOVFW	ILK_DEGER
	ADDWF	SONUC,F
	DECFSZ	SON_DEGER
	GOTO	CARPMA_SONUC
	RETURN
	
BOLME_SONUC
	MOVFW	SON_DEGER
	SUBWF	ILK_DEGER,W
	BTFSS	STATUS,C
	RETURN
	MOVWF	ILK_DEGER
	INCF	SONUC
	GOTO	BOLME_SONUC
	
KARAKTER_BOL
	BASAMAK100
	MOVLW	D'100'
	SUBWF	SONUC,W
	BTFSS	STATUS,C
	GOTO	$+4
	INCF	YUZLER
	MOVWF	SONUC
	GOTO	BASAMAK100
	
	BASAMAK10
	MOVLW	D'10'
	SUBWF	SONUC,W
	BTFSS	STATUS,C
	GOTO	$+4
	INCF	ONLAR
	MOVWF	SONUC
	GOTO	BASAMAK10
	
	MOVFW	SONUC
	MOVWF	BIRLER
	
	RETURN
END	; Program sonu
