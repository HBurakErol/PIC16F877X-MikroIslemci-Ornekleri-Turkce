#INCLUDE  <P16F877A.INC>
LIST 		P=16F877A

ORG		0X00
GECIKME1	EQU	0x20    ; GEC?KME 1. DONGU
GECIKME2	EQU	0x21    ; GECIKME 2. DONGU
GECIKME3	EQU	0x22    ; GECIKME 3.DONGU

DUSUK_4		EQU	0x23	; 4 BITLIK KOMUT GONDERIMINDE KULLANILACAK
VERI		EQU	0x24	; 8 BITLIK LCD VERISI TUTULACAK
SATIR_KONUM	EQU	0x25	; LCD EKRANIN GIDILECEK SATIR BILGISI
SUTUN_KONUM	EQU	0x26	; LCD EKRANIN GIDILECEK SUTUN BILGISI

ILK_DEGER	EQU	0X27
SON_DEGER	EQU	0X28	
ISLEM_REG	EQU	0X29
BIRLER		EQU	0X2A
ONLAR		EQU	0X2B
YUZLER		EQU	0X2C
ARA		EQU	0X2D
SONUC		EQU	0X2E
OKUNAN_DEGER	EQU	0X2F
		
CALL	AYARLA
GOTO	DONUSTUR

GECIKME_200USN				
	MOVLW	0xC8
	MOVWF	GECIKME1
	DNGU1
	DECFSZ	GECIKME1,1 
	GOTO	DNGU1	    	
	RETURN
	
GECIKME_5MSN
	movlw	0xE7
	movwf	GECIKME1
	movlw	0x04
	movwf	GECIKME2
	CALL	GECIKTIR
	RETURN
	
GECIKME_50MSN
	movlw	0x0F
	movwf	GECIKME1
	movlw	0x28
	movwf	GECIKME2
	CALL	GECIKTIR
	RETURN

GECIKME_196MS
	movlw	0xFF
	movwf	GECIKME1
	movlw	0xFF
	movwf	GECIKME2
	CALL	GECIKTIR
	RETURN
GECIKTIR
	decfsz	GECIKME1, f
	goto	GECIKTIR
	decfsz	GECIKME2, f
	goto	GECIKTIR
	RETURN
	
DUSEN_KENAR
	BANKSEL	PORTB
	BSF	PORTB,5		;E UCUNU ONCE 1 YAP
	CALL	GECIKME_200USN	;ASLINDA BU KADAR UZUN OLMAK ZORUNDA DEGIL
	BCF	PORTB,5		; E UCUNU TEKRAR 0 YAP
	RETURN
	
KOMUT_4BIT
	ANDLW	0x0F	; W 'DAKI DEGERIN SADECE ILK DORT BITINI AL SAKLA
	MOVWF	DUSUK_4
	
	MOVF	PORTB,W	; PORTB NIN EN DEGERLI 4 BITINI ALMAK ICIN W 'YA GETIR
	ANDLW	0xF0	; SADECE EN DEGERLI 4 BITI
	
	IORWF	DUSUK_4,W   ; ILK DORT BITI TUTAN DEGISKEN ILE PORTB NIN SON 4 UNU VEYA ISLEMI ILE BIRLESTIR
	
	MOVWF	PORTB	;BIRLESMIS VERIYI LCD YE GONDER. BOYLECE MEVCUT PORTB DURUMU KORUNMUS OLDU
	
	CALL	DUSEN_KENAR ; KOMUT GONDERMEK ICIN E UCUNAN DUSEN KENAR GONDER
	CALL	GECIKME_200USN
	RETURN
	
KOMUT_8BIT
	MOVWF	VERI	; ONCE GONDERILECEK VERIYI SAKLA
	SWAPF	VERI,W	; GONDERILECEK VERININ ILK DOR VE SON DORT BITINI YER DEGISTIR VE W YA AT
	
	BANKSEL	PORTB
	BCF	PORTB,4	; RS UCUNU 0 A CEK VE KOMUT GONDERECEGINI SOYLE
	
	CALL	KOMUT_4BIT  ; BU EN DEGERLIKLI 4 BITI YOLLA
	
	MOVF	VERI,W	    ; SIMDI EN DEGERLIKSIZ 4 U GONDER ( VERI DEGISKENI NORMAL DURUMU TUTUYORDU)
	BCF	PORTB,4	; RS UCUNU 0 A CEK VE KOMUT GONDERECEGINI SOYLE
	CALL	KOMUT_4BIT
	
	RETURN
LCD_KARAKTER_YAZ
	MOVWF	VERI	    ; GELEN VERI ICIN SWAP ISLEMI YAPILACAGINDAN KORU
	SWAPF	VERI,W	    ; EN DEGERLIKLI BITLER ICIN SWAP YAP
	BANKSEL	PORTB
	BSF	PORTB,4	    ; KARAKTER YAZMA ICIN RS=1
	CALL	KOMUT_4BIT  ; 4 BIT MODUNDA KARAKTERI GONDER
	MOVF	VERI,W	    ; SIMDI NORMAL DUSUK DEGERLIKLI BITLERI GONDER
	CALL	KOMUT_4BIT
	RETURN
	
;****************************************************************************************************
AYARLA
	BANKSEL	TRISD
	MOVLW	0XF0
	MOVWF	TRISD
	BANKSEL	PORTB


	BANKSEL	TRISB
	CLRF	TRISB
	MOVLW	0X0F
	MOVWF	TRISD

	BANKSEL	PORTB
	BSF	PORTD,4
	CALL	GECIKME_50MSN	;LCD ILK ACILIS GECIKMESI
	
	BCF	PORTB,4		;RS UCUNU 0 YAPARAK LCD YE KOMUT GONDERECEGINI SOYLE
	
	MOVLW	0x03
	CALL	KOMUT_4BIT
	CALL	GECIKME_5MSN
	
	CALL	DUSEN_KENAR
	CALL	GECIKME_200USN
	CALL	DUSEN_KENAR
	CALL	GECIKME_200USN
	
	BCF	PORTB,4
	MOVLW	0x02
	CALL	KOMUT_4BIT
	CALL	GECIKME_200USN
	
	MOVLW	0x28
	CALL	KOMUT_8BIT
	
	MOVLW	0x10		; EKRAN AKTIF, IMLEC YAN SON
	CALL	KOMUT_8BIT
	
	MOVLW	0x01
	CALL	KOMUT_8BIT
	
	CALL	GECIKME_5MSN
	
	MOVLW	0x06
	CALL	KOMUT_8BIT
	
	MOVLW	0x0D
	CALL	KOMUT_8BIT
	
	BANKSEL ADCON0
	MOVLW	0X81
	MOVWF	ADCON0

	BANKSEL ADCON1
	MOVLW	B'10000000'
	MOVWF	ADCON1

	BANKSEL TRISA
	MOVLW	0XFF
	MOVWF	TRISA
	
	
	RETURN

	DONUSTUR
	MOVLW	0X01
	CALL	KOMUT_8BIT
	
	BANKSEL ADCON0
	BSF	ADCON0,GO
	CALL	GECIKME_196MS

	BTFSC	ADCON0,GO
	GOTO	$-1
	BCF	STATUS,C
	BANKSEL	ADRESH
	RRF	ADRESH
	
	BANKSEL ADRESL
	RRF	ADRESL
	MOVFW	ADRESL
	BCF	STATUS,RP0
	MOVWF	OKUNAN_DEGER
	
	MOVFW	OKUNAN_DEGER
	SUBLW	.205
	BTFSS	STATUS,C
	GOTO	DONUSTUR
	
	MOVLW	.55
	SUBWF	OKUNAN_DEGER,W
	BTFSC	STATUS,C
	GOTO	$+7
	MOVLW	A'-'
	CALL	LCD_KARAKTER_YAZ
	MOVFW	OKUNAN_DEGER
	SUBLW	.55
	MOVWF	OKUNAN_DEGER
	GOTO	$+5
	MOVWF	OKUNAN_DEGER
	MOVLW	A'+'
	CALL	LCD_KARAKTER_YAZ
	
	MOVFW	OKUNAN_DEGER
	CALL	KARAKTER_BOL
	
	
	MOVLW	.48
	ADDWF	YUZLER,W
	CALL	LCD_KARAKTER_YAZ
	
	MOVLW	.48
	ADDWF	ONLAR,W
	CALL	LCD_KARAKTER_YAZ
	
	MOVLW	.48
	ADDWF	BIRLER,W
	CALL	LCD_KARAKTER_YAZ
	
	MOVLW	A' '
	CALL	LCD_KARAKTER_YAZ
	MOVLW	A'°'
	CALL	LCD_KARAKTER_YAZ
	MOVLW	A'C'
	CALL	LCD_KARAKTER_YAZ
	
	CALL	GECIKME_196MS
	GOTO	DONUSTUR
	
	

KARAKTER_BOL
	MOVWF	SONUC
	CLRF	YUZLER
	CLRF	ONLAR
	CLRF	BIRLER
	
	BASAMAK100
	MOVLW	D'100'
	SUBWF	SONUC,W
	BTFSS	STATUS,C
	GOTO	$+4
	INCF	YUZLER
	MOVWF	SONUC
	GOTO	BASAMAK100
	
	BASAMAK10
	MOVLW	D'10'
	SUBWF	SONUC,W
	BTFSS	STATUS,C
	GOTO	$+4
	INCF	ONLAR
	MOVWF	SONUC
	GOTO	BASAMAK10
	
	MOVFW	SONUC
	MOVWF	BIRLER
	
	RETURN
END	; Program sonu



