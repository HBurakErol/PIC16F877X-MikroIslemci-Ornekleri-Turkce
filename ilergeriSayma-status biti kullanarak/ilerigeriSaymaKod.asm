#include	<p16f877A.inc>
list		p=16f877A
GECIKME1	EQU	0x20    ;GEC?KME 1. DONGU
GECIKME2	EQU	0x21    ;GECIKME 2. DONGU
GECIKME3	EQU	0x22    ;GECIKME 3.DONGU
ORG 0X00
nop
GOTO BASLA

ORG 0X04

PORTA_AYARLA:
BANKSEL TRISA
MOVLW 0X06
MOVWF ADCON1
MOVLW b'00110000'
MOVWF TRISA
BANKSEL	PORTA
CLRF	PORTA
RETURN

PORTB_AYARLA:
BANKSEL TRISB
CLRF TRISB
BANKSEL PORTB
CLRF PORTB
RETURN

BASLA:
call PORTA_AYARLA
call PORTB_AYARLA

KONTROL:
BTFSC PORTA,4
GOTO AZALT
NOP
BTFSC PORTA,5
GOTO ARTTIR
NOP
GOTO KONTROL

ARTTIR:
BANKSEL PORTB
D1
BTFSS PORTA, 4
GOTO	$+2
GOTO AZALT
CALL GECIKME
INCF PORTB
BTFSS STATUS,2
GOTO D1
INCF PORTA
GOTO D1


AZALT:
BANKSEL PORTB
D2
BTFSS PORTA, 5
GOTO	$+2
GOTO ARTTIR
CALL GECIKME
DECF PORTB
BTFSS STATUS,2
GOTO D2
DECF PORTA
GOTO D2




GECIKME:				; (herbir komut 4mhz de 1mikrosn) = 1 sn GEC?KME (yakla??k)
	MOVLW	0x08
	MOVWF	GECIKME1	
	
	MOVLW	0x2F
	MOVWF	GECIKME2
	MOVLW	0x03
	MOVWF	GECIKME3
DONGU1
	DECFSZ	GECIKME1,1
	GOTO	$+2
	DECFSZ	GECIKME2,1
	GOTO	$+2
	DECFSZ	GECIKME3,1
	GOTO	DONGU1
	
	NOP
	NOP
	NOP	
	RETURN



end