#INCLUDE  <P16F877A.INC>
LIST 		P=16F877A

ORG		0X00
GECIKME1	EQU	0x20    ;GEC?KME 1. DONGU
GECIKME2	EQU	0x21    ;GECIKME 2. DONGU
GECIKME3	EQU	0x22    ;GECIKME 3.DONGU

DUSUK_4		EQU	0x23	;4 BITLIK KOMUT GONDERIMINDE KULLANILACAK
VERI		EQU	0x24	; 8 BITLIK LCD VERISI TUTULACAK
SATIR_KONUM	EQU	0x25	; LCD EKRANIN GIDILECEK SATIR BILGISI
SUTUN_KONUM	EQU	0x26	; LCD EKRANIN GIDILECEK SUTUN BILGISI



NOP
GOTO 		BASLA

ORG		0X04


GECIKME_200USN				
	MOVLW	0xC8
	MOVWF	GECIKME1
DNGU1
	DECFSZ	GECIKME1,1
	GOTO	DNGU1
	RETURN
	
	GECIKME_5MSN
	movlw	0xE7
	movwf	GECIKME1
	movlw	0x04
	movwf	GECIKME2
D5_D
	decfsz	GECIKME1, f
	goto	D5_D
	decfsz	GECIKME2, f
	goto	D5_D
	RETURN
;******************************************************************************************************
	
GECIKME_50MSN
	movlw	0x0F
	movwf	GECIKME1
	movlw	0x28
	movwf	GECIKME2
D50_D
	decfsz	GECIKME1, f
	goto	D50_D
	decfsz	GECIKME2, f
	goto	D50_D
	RETURN
	
DUSEN_KENAR
	BANKSEL	PORTB
	BSF	PORTB,5		;E UCUNU ONCE 1 YAP
	CALL	GECIKME_200USN	;ASLINDA BU KADAR UZUN OLMAK ZORUNDA DEGIL
	BCF	PORTB,5		; E UCUNU TEKRAR 0 YAP
	RETURN
	
	KOMUT_4BIT
	; BU FONKSIYON 4 BITLIK KOMUT GONDERME ICIN KULLANILIR
	;BURADA DIKKAT EDILMESI GEREKEN PORTB NIN AYAR BITLERINI DE ICEREN 4-7 NOLU BITLERININ DURUMLARININ BOZULMAMASI
	;GONDERILECEK 4 BIT BU FONKSIYON CAGRILMADAN	W YA YUKLENMELI. BUNLARI BIT BIT GONDERMEKTENSE MEVCUT PORTB NIN
	;DEGERLI 4 BITI ILE GELEN W VERISININ 4 BITINI BIRLESTIR
	
	ANDLW	0x0F	; W 'DAKI DEGERIN SADECE ILK DORT BITINI AL SAKLA
	MOVWF	DUSUK_4
	
	MOVF	PORTB,W	; PORTB NIN EN DEGERLI 4 BITINI ALMAK ICIN W 'YA GETIR
	ANDLW	0xF0	; SADECE EN DEGERLI 4 BITI
	
	IORWF	DUSUK_4,W   ; ILK DORT BITI TUTAN DEGISKEN ILE PORTB NIN SON 4 UNU VEYA ISLEMI ILE BIRLESTIR
	
	MOVWF	PORTB	;BIRLESMIS VERIYI LCD YE GONDER. BOYLECE MEVCUT PORTB DURUMU KORUNMUS OLDU
	
	CALL	DUSEN_KENAR ; KOMUT GONDERMEK ICIN E UCUNAN DUSEN KENAR GONDER
	CALL	GECIKME_200USN
	RETURN
	
	KOMUT_8BIT
	; BU FONKSIYON 8 BITLIK KOMUT GONDERMEK ICIN KULLANILACAK. CALISMASINDA YUKARIDAKI KOMUT_4 FONKSIYONUNDAN
	; FAYDALANACAK. BU FONKSIYON CAGRILDIGINDA GONDERILECEK VERI W 'YA YUKLENMIS OLMALI
	; GONDERILECEK KOMUTUN ONCE EN DEGERLIKLI 4 BITI SONRA EN DEGERLIKSIZ 4 BITI GONDERILECEK
	; ONCE EN DEGERLI 4 BITINI GONDERMEK ICIN SWAPF KOMUTU ILE SON 4 BIT BASA GETIRILIR
	
	MOVWF	VERI	; ONCE GONDERILECEK VERIYI SAKLA
	SWAPF	VERI,W	; GONDERILECEK VERININ ILK DOR VE SON DORT BITINI YER DEGISTIR VE W YA AT
	
	BANKSEL	PORTB
	BCF	PORTB,4	; RS UCUNU 0 A CEK VE KOMUT GONDERECEGINI SOYLE
	
	CALL	KOMUT_4BIT  ; BU EN DEGERLIKLI 4 BITI YOLLA
	
	MOVF	VERI,W	    ; SIMDI EN DEGERLIKSIZ 4 U GONDER ( VERI DEGISKENI NORMAL DURUMU TUTUYORDU)
	BCF	PORTB,4	; RS UCUNU 0 A CEK VE KOMUT GONDERECEGINI SOYLE
	CALL	KOMUT_4BIT
	
	RETURN
LCD_KARAKTER_YAZ
	MOVWF	VERI	; GELEN VERI ICIN SWAP ISLEMI YAPILACAGINDAN KORU
	SWAPF	VERI,W	    ; EN DEGERLIKLI BITLER ICIN SWAP YAP
	BANKSEL	PORTB
	BSF	PORTB,4	    ; KARAKTER YAZMA ICIN RS=1
	CALL	KOMUT_4BIT  ; 4 BIT MODUNDA KARAKTERI GONDER
	MOVFW	VERI	    ; SIMDI NORMAL DUSUK DEGERLIKLI BITLERI GONDER
	CALL	KOMUT_4BIT
	RETURN
	
;****************************************************************************************************
LCD_AYARLA
	BANKSEL	TRISB
	CLRF	TRISB
	
	BANKSEL	PORTB
		
	CALL	GECIKME_50MSN	;LCD ILK ACILIS GECIKMESI
	
	
	BCF	PORTB,4		;RS UCUNU 0 YAPARAK LCD YE KOMUT GONDERECEGINI SOYLE
	
	MOVLW	0x03
	CALL	KOMUT_4BIT
	CALL	GECIKME_5MSN
	
	CALL	DUSEN_KENAR
	CALL	GECIKME_200USN
	CALL	DUSEN_KENAR
	CALL	GECIKME_200USN
	
	BCF	PORTB,4
	MOVLW	0x02
	CALL	KOMUT_4BIT
	CALL	GECIKME_200USN
	
	
	
	MOVLW	0x28
	CALL	KOMUT_8BIT
	
	MOVLW	0x10		; EKRAN AKTIF, IMLEC YAN SON
	CALL	KOMUT_8BIT
	
	MOVLW	0x01
	CALL	KOMUT_8BIT
	
	CALL	GECIKME_5MSN
	
	MOVLW	0x06
	CALL	KOMUT_8BIT
	
	MOVLW	0x0D
	CALL	KOMUT_8BIT
	
	RETURN
;*******************************************************************************************************
	
KURSOR_KONUM
	MOVLW	0x80		    ; EKRANIN ILK SATIR BIRINCI SUTUN NOKTA KOORDINATI 0x80 DIR
	MOVF	SATIR_KONUM,1	    ; KENDI UZERINE KOPYALA, EGER 0 ISE SIFIRINCI SATIRDA KAL
	BTFSS	STATUS,Z	    ; EGER DEGILSE IKINCI SATIR BASLANGIC ADRESI 0x80 DEN BASLA
	MOVLW	0xC0
	ADDWF	SUTUN_KONUM,W	    ; SATIR BELLI OLDU SUTUN SAYISINI EKLE VE KONUMA GIT
	CALL	KOMUT_8BIT
	RETURN

;*******************************************************************************************************
	
BASLA
	CALL LCD_AYARLA
	
	MOVLW	.65
	CALL	LCD_KARAKTER_YAZ
	
MOVLW	.32
	CALL	LCD_KARAKTER_YAZ	
	
	MOVLW	.66
	CALL	LCD_KARAKTER_YAZ
	
	MOVLW	.32
	CALL	LCD_KARAKTER_YAZ
	
	MOVLW	.67
	CALL	LCD_KARAKTER_YAZ
	
	MOVLW	.1
	MOVWF	SATIR_KONUM
	MOVLW	.0
	MOVWF	SUTUN_KONUM
	CALL	KURSOR_KONUM
GG
	GOTO	GG
	END                       ; Program sonu

